

/ {
	chosen {
		zmk,kscan = &kscan0;
	};

	kscan0: kscan_0 {
		compatible = "zmk,kscan-gpio-direct";

		label = "KSCAN";

		input-gpios
			= <&gpio0 10 (GPIO_ACTIVE_HIGH | GPIO_PULL_UP)>
			;
	};

};
