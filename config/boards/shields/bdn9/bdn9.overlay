#include "bdn9.dtsi"

/ {
	chosen {
		zmk,kscan = &kscan0;
	};

	kscan0: kscan_0 {
		compatible = "zmk,kscan-gpio-direct";

		label = "KSCAN";

		input-gpios
			= <&teton_col 0 (GPIO_ACTIVE_LOW | GPIO_PULL_UP)>
			, <&teton_col 1 (GPIO_ACTIVE_LOW | GPIO_PULL_UP)>
			, <&teton_col 2 (GPIO_ACTIVE_LOW | GPIO_PULL_UP)>
			, <&gpio0 7 (GPIO_ACTIVE_LOW | GPIO_PULL_UP)>
			, <&gpio0 9 (GPIO_ACTIVE_LOW | GPIO_PULL_UP)>
			, <&gpio0 10 (GPIO_ACTIVE_LOW | GPIO_PULL_UP)>
			, <&gpio0 12 (GPIO_ACTIVE_LOW | GPIO_PULL_UP)>
			, <&gpio0 19 (GPIO_ACTIVE_LOW | GPIO_PULL_UP)>
			, <&gpio0 21 (GPIO_ACTIVE_LOW | GPIO_PULL_UP)>
			;
	};

};

&left_encoder {
    status = "okay";
};