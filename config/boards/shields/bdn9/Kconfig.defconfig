## config/boards/shields/bdn9/Kconfig.defconfig
```kconfig
if SHIELD_BDN9

config ZMK_KEYBOARD_NAME
	default "teton"

config ZMK_KSCAN_DIRECT_POLLING
	default y
	
endif
```

## config/boards/shields/onekey/Kconfig.defconfig
```kconfig
if SHIELD_ONEKEY

config ZMK_KEYBOARD_NAME
	default "onekey"

config ZMK_KSCAN_DIRECT_POLLING
	default y
	
endif
```
